## kernel/drivers/sharp/Kconfig
```kconfig
#
# SHARP configuration
#

menu "SHARP Device Drivers"


source "drivers/sharp/mfc/Kconfig"
source "drivers/sharp/shdiag/Kconfig"
source "drivers/sharp/tunerdrv/Kconfig"
source "drivers/sharp/tunerdrv_tmm/Kconfig"
source "drivers/sharp/shtps/Kconfig"
#/*SH_AUDIO_DRIVER->*//*02-092*/
source "drivers/sharp/shaudio/Kconfig"
#/*SH_AUDIO_DRIVER<-*//*02-092*/
source "drivers/sharp/presenter/Kconfig"
source "drivers/sharp/shmds/Kconfig"
source "drivers/sharp/shtimer/Kconfig"
source "drivers/sharp/shterm/Kconfig"
source "drivers/sharp/shlog/Kconfig"
source "drivers/sharp/shirda/Kconfig"
source "drivers/sharp/shcamled/Kconfig"
source "drivers/sharp/proximity/Kconfig"
source "drivers/sharp/vold/Kconfig"
source "drivers/sharp/shmhl/Kconfig"
source "drivers/sharp/shswic/Kconfig"

source "drivers/sharp/shuim/Kconfig"

source "drivers/sharp/shgeiger/Kconfig"

source "drivers/sharp/shsys/Kconfig"

source "drivers/sharp/phsmdm/Kconfig"

endmenu
```

## kernel/drivers/sharp/mfc/Kconfig
```kconfig
#
# FeliCa device configuration
#

menu "FeliCa driver"

comment "SHARP FeliCa device drivers"

config SHFELICA
	bool "FeliCa device drivers"
	depends on SERIAL_MSM_HSL && I2C
	default y
	help
	  Enable FeliCa driver.

config SHSNFC
	bool "NFC device drivers"
	depends on SHFELICA
	default n
	help
	  Enable NFC driver.

config SHSNFC_BATTERY_FIXATION
	bool "MVDD device drivers"
	depends on SHFELICA
	default n
	help
	  Enable MVDD device drivers.

config SHSNFC_MVDD_GPIO
	int "MVDD GPIO number"
	range 0 999
	default "0"

endmenu
```

## kernel/drivers/sharp/phsmdm/Kconfig
```kconfig
#
# PHS
#

menu "PHS_MDM"

config PHS_MDM
	tristate "PHS_MDM"
	default n
endmenu
```

## kernel/drivers/sharp/proximity/Kconfig
```kconfig
#
# Proximity device configuration
#
# drivers/sharp/proximity/Kconfig

menu "Proximity Configuration"

config SENSORS_PROXIMITY
	tristate "Proximity Sensor Driver"
	default n

config PROXIMITY_MODEL_TYPE
	int "PROXIMITY MODEL TYPE"
	depends on SENSORS_PROXIMITY
	range 0 8
	default "0"

endmenu
```

## kernel/drivers/sharp/shaudio/Kconfig
```kconfig
#
# audio device configuration
#
# CONFIG_SH_AUDIO_DRIVER newly created

menu "SHARP audio driver"

comment "SHARP audio drivers"

#/*SH_AUDIO_DRIVER->*//*02-016*/
config SH_AUDIO_DRIVER_MODEL_NUMBER
	int "SH_AUDIO_DRIVER_MODEL_NUMBER"
	range 0 999
	default "0"
#/*SH_AUDIO_DRIVER<-*//*02-016*/

#/*SH_AUDIO_DRIVER->*//*02-092*/
config SH_AUDIO_DRIVER
	tristate "SHARP Audio Driver customized"
	default y
#/*SH_AUDIO_DRIVER<-*//*02-092*/

#/*SH_AUDIO_DRIVER->*//*02-046*/
config SHSPAMP_YDA168B
	tristate "SHARP spamp yda168b"
	default y
#/*SH_AUDIO_DRIVER<-*//*02-046*/

#/*SH_AUDIO_DRIVER->*//*02-141*/
config SHRECEIVER_LM48560
	tristate "SHARP receiver lm48560"
	default n
#/*SH_AUDIO_DRIVER<-*//*02-141*/

#/*SH_AUDIO_DRIVER->*//*02-136*/
config SHGPIO_HS_DETECT
	tristate "SHARP GPIO HS DETECT"
	default n
#/*SH_AUDIO_DRIVER<-*//*02-136*/

#/*SH_AUDIO_DRIVER->*//*02-179*/
config SH_AUDIO_DRIVER_PHS
 tristate "SHARP Audio Driver PHS customized"
 default n
#/*SH_AUDIO_DRIVER<-*//*02-179*/
endmenu
```

## kernel/drivers/sharp/shmhl/Kconfig
```kconfig
#
# SHMHL device configuration
#
menu "SHMHL driver"
comment "SHARP MHL device drivers"

config SII8334_MHL_TX
	bool "Sharp MHL Driver"
	default n
	help
	  SHMHL Support.

config SII8334_MHL_TX_WITH_SWIC
	bool "Sharp MHL Driver with SWIC"
	depends on SII8334_MHL_TX
	default n
	help
	  SHMHL with SWIC Support.

endmenu
```

## kernel/drivers/sharp/shswic/Kconfig
```kconfig
# drivers/sharp/shswic/Kconfig

menu "SHARP SWIC Device Drivers"

config USB_SWIC
	bool "USB switch IC Driver"

config CRADLE_SWIC
	bool "CRADLE switch IC Driver"

config HOST_SWIC
	bool "HOST switch IC Driver"

config HEADSET_BUTTON_SWIC
	bool "HEADSET BUTTON enable IC Driver"

config HARDWARE_REV_TYPE_1_SWIC
	bool "HARDWARE REV CHECK TYPE 1"

config HARDWARE_REV_TYPE_2_SWIC
	bool "HARDWARE REV CHECK TYPE 2"

endmenu
```

## kernel/drivers/sharp/shsys/Kconfig
```kconfig
#
# SMEM driver configuration
#

menu "SHSMEM driver"

comment "SHARP SMEM driver"

config SHSMEM_CUST_SMARTPHONE
	bool "Customize for smartphone"
	depends on SHSYS_CUST
        default n
	help
	  for smartphone

config SHSMEM_CUST_TABLET
	bool "Customize for tablet"
	depends on SHSYS_CUST
	default n
	help
	  for tablet

endmenu
```

## kernel/drivers/sharp/shtps/Kconfig
```kconfig
#
# Sharp Touchscreen configuration
#

menu "SHTPS driver"

comment "SHARP Touchscreen device drivers"

config TOUCHSCREEN_SHTPS
	bool "SHARP Touchscreens"
	default n

if TOUCHSCREEN_SHTPS

	source "drivers/sharp/shtps/tma4xx/Kconfig"

	source "drivers/sharp/shtps/sy3000/Kconfig"

	source "drivers/sharp/shtps/nassau/Kconfig"

endif # TOUCHSCREEN_SHTPS

endmenu
```

## kernel/drivers/sharp/shtps/nassau/Kconfig
```kconfig
#
# Sharp Touchscreen configuration
#

if TOUCHSCREEN_SHTPS
	config SHTPS_NASSAU_DEV
		tristate "Nassau Device"
		default n
		depends on TOUCHSCREEN_SHTPS

	config SHTPS_NASSAU_TS2_001
		tristate "Nassau TS2_001"
		default n
		depends on SHTPS_NASSAU_DEV

endif # TOUCHSCREEN_SHTPS
```

## kernel/drivers/sharp/shtps/sy3000/Kconfig
```kconfig
#
# Sharp Touchscreen configuration
#

if TOUCHSCREEN_SHTPS

	config SHTPS_SY3X00_DEV
		tristate "SY3x00 Device"
		default n
		depends on TOUCHSCREEN_SHTPS

	config SHTPS_SY3000_TM2215_001
		tristate "SY3000 TM2215-001"
		default n
		depends on SHTPS_SY3X00_DEV

	config SHTPS_SY3000_TM2314_001
		tristate "SY3000 TM2314-001"
		default n
		depends on SHTPS_SY3X00_DEV

	config SHTPS_SY3000_TM2376_001
		tristate "SY3000 TM2376-001"
		default n
		depends on SHTPS_SY3X00_DEV

	config SHTPS_SY3000_TM2731_001
		tristate "SY3000 TM2731-001"
		default n
		depends on SHTPS_SY3X00_DEV

endif # TOUCHSCREEN_SHTPS
```

## kernel/drivers/sharp/shtps/tma4xx/Kconfig
```kconfig
#
# Sharp Touchscreen configuration
#

if TOUCHSCREEN_SHTPS

	config SHTPS_TMA4XX_DEV
		tristate "TMA4XX Device"
		default n
		depends on TOUCHSCREEN_SHTPS

	config SHTPS_TMA4XX_TMA463_002
		tristate "TMA4XX TMA463-002"
		default n
		depends on SHTPS_TMA4XX_DEV

endif # TOUCHSCREEN_SHTPS
```

## kernel/drivers/sharp/shuim/Kconfig
```kconfig
#
# SHUim device configuration
#

menu "SHUim driver"

comment "SHARP Uim drivers"

config SHUIM
	bool "SHUim Support"
	default y
	help
	  Uim Support.

endmenu
```
